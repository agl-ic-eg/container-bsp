## meta-rcar-gen3-guest/conf/machine/h3ulcb-guest.conf
```bitbake
#@TYPE: Machine
#@NAME: H3ULCB machine for container guest
#@DESCRIPTION: Machine configuration for running H3ULCB container guest

require conf/machine/h3ulcb.conf

KERNEL_IMAGETYPE = ""
SERIAL_CONSOLES = ""

# Configuration for kernel
PREFERRED_PROVIDER_virtual/kernel = "linux-dummy"
KERNEL_DEVICETREE = ""

# Configuration for ARM Trusted Firmware
EXTRA_IMAGEDEPENDS_remove = " arm-trusted-firmware optee-os"

# u-boot
PREFERRED_VERSION_u-boot = ""
EXTRA_IMAGEDEPENDS_remove = "u-boot"
UBOOT_MACHINE = ""
```

## meta-rcar-gen3-guest/conf/machine/m3ulcb-guest.conf
```bitbake
#@TYPE: Machine
#@NAME: M3ULCB machine for guest
#@DESCRIPTION: Machine configuration for running M3ULCB

require conf/machine/m3ulcb.conf

KERNEL_IMAGETYPE = ""
SERIAL_CONSOLES = ""

# Configuration for kernel
PREFERRED_PROVIDER_virtual/kernel = "linux-dummy"
KERNEL_DEVICETREE = ""

# Configuration for ARM Trusted Firmware
EXTRA_IMAGEDEPENDS_remove = " arm-trusted-firmware optee-os"

# u-boot
PREFERRED_VERSION_u-boot = ""
EXTRA_IMAGEDEPENDS_remove = "u-boot"
UBOOT_MACHINE = ""
```
